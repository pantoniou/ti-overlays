#include <dt-bindings/interrupt-controller/irq.h>

/ {
    fragment@201 {
        target-path = "/";
        __overlay__ {
	    model = "TI AM572x IDK-LCD-OSD-Display";
        };
    };

    /*
     * Original was:
     *
     * fragment@202 {
     *   target = <&touchscreen>;
     *    __overlay__ {
     *        interrupt-parent = <&gpio3>;
     *        interrupts = <14 IRQ_TYPE_EDGE_FALLING>;
     *    };
     * };
     *
     * Changed because an overlay can not have a target
     * defined in itself; the dtsi files do not have that
     * problem.
     */

    fragment@202 {
        target = <&i2c1>;
        __overlay__ {
            edt-ft5506@38 {
                interrupt-parent = <&gpio3>;
                interrupts = <14 IRQ_TYPE_EDGE_FALLING>;
	    };
        };
    };
};
