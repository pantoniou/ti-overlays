/dts-v1/;
/plugin/;

#include <dt-bindings/interrupt-controller/irq.h>

#include "dra7x-evm-lcd-osd-overlay.dtsi"

/ {
    /* Original was:
     *
     * fragment@1 {
     *    target = <&touchscreen>;
     *    __overlay__ {
     *        interrupt-parent = <&gpio1>;
     *        interrupts = <15 IRQ_TYPE_EDGE_FALLING>;
     *    };
     * };
     *
     * Changed because an overlay can not have a target
     * defined in itself; the dtsi files do not have that
     * problem.
     */

    fragment@1 {
        target = <&i2c1>;
        __overlay__ {
            edt-ft5506@38 {
                interrupt-parent = <&gpio1>;
                interrupts = <15 IRQ_TYPE_EDGE_FALLING>;
	    };
        };
    };
};
