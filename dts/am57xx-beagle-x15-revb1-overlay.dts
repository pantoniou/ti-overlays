/dts-v1/;
/plugin/;

#include <dt-bindings/gpio/gpio.h>

/ {
    fragment@1 {
        target-path = "/";
        __overlay__ {
            model = "TI AM5728 BeagleBoard-X15 rev B1";
        };
    };

    fragment@2 {
        target = <&tpd12s015>;
        __overlay__ {
			gpios = <&gpio7 10 GPIO_ACTIVE_HIGH>,	/* gpio7_10, CT CP HPD */
			        <&gpio2 30 GPIO_ACTIVE_HIGH>,	/* gpio2_30, LS OE */
			        <&gpio7 12 GPIO_ACTIVE_HIGH>;	/* gpio7_12/sp1_cs2, HPD */
        };
    };
    fragment@3 {
        target = <&mmc1>;
        __overlay__ {
            vmmc-supply = <&vdd_3v3>;
            vmmc-aux-supply = <&ldo1_reg>;
        };
    };
};
