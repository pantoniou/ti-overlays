/dts-v1/;
/plugin/;

#include "dra7x-evm-lcd-osd-overlay.dtsi"
#include "dra7-evm-lcd-osd-overlay.dtsi"

/ {
    /* Original was:
     *
     * fragment@1 {
     *    target = <&lcd>;
     *   __overlay__ {
     *       #include "lcd-osd101t2587.dtsi"
     *   };
     * };
     *
     * Changed because an overlay can not have a target
     * defined in itself; the dtsi files do not have that
     * problem.
     */

    fragment@1 {
        target-path = "/";
        __overlay__ {
            display {
                #include "lcd-osd101t2587.dtsi"
	    };
        };
    };
};
